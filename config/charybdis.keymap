// Source keypos definitions
#include "zmk-helpers/key-labels/42.h"

/* map Corne's extra keys */
#define X_LT    &kp TAB
#define X_RT    &kp BSLH

#define X_LM    &kp ESC
#define X_RM    &kp SQT

#define X_LB    &kp LSHFT
#define X_RB    &kp RSHFT

#define X_MH    &mo MOUSE  &kp LGUI 
#define X_MH_M  &mkp LCLK  &mkp RCLK

/* activate bluetooth */
#define CONFIG_WIRELESS 1

/* leds and backlights */
#include <dt-bindings/zmk/rgb.h>
#include <dt-bindings/zmk/backlight.h>

/* source the main keymap */
#include "base.keymap"
