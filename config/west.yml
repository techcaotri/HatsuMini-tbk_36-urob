## config/west.yml
```yaml
manifest:
  remotes:
    - name: zmkfirmware
      url-base: https://github.com/petejohanson
    - name: inorichi
      url-base: https://github.com/inorichi
    - name: dhruvinsh
      url-base: https://github.com/dhruvinsh
    - name: urob
      url-base: https://github.com/urob
  projects:
    - name: zmk
      remote: zmkfirmware
      revision: feat/pointers-move-scroll
      import: app/west.yml
    - name: zmk-pmw3610-driver
      remote: inorichi
      revision: main
    - name: zmk-helpers
      remote: urob
      revision: main
    - name: zmk-tri-state
      remote: dhruvinsh
      revision: main
  self:
    path: config
```
